## Config.in
```kconfig
source "$BR2_EXTERNAL_BITBOX_PATH/package/retroarch/Config.in"
source "$BR2_EXTERNAL_BITBOX_PATH/package/libretro-fbneo/Config.in"
source "$BR2_EXTERNAL_BITBOX_PATH/package/libretro-genesisplusgx/Config.in"
source "$BR2_EXTERNAL_BITBOX_PATH/package/libretro-nestopia/Config.in"
source "$BR2_EXTERNAL_BITBOX_PATH/package/libretro-pcsx-rearmed/Config.in"
source "$BR2_EXTERNAL_BITBOX_PATH/package/libretro-pocketsnes/Config.in"

source "$BR2_EXTERNAL_BITBOX_PATH/package/rpi_ws281x/Config.in"
source "$BR2_EXTERNAL_BITBOX_PATH/package/retroleds/Config.in"

source "$BR2_EXTERNAL_BITBOX_PATH/package/sfml/Config.in"
source "$BR2_EXTERNAL_BITBOX_PATH/package/attractmode/Config.in"
source "$BR2_EXTERNAL_BITBOX_PATH/package/attract-bitbox-layout/Config.in"

source "$BR2_EXTERNAL_BITBOX_PATH/package/mk_arcade_joystick_rpi/Config.in"

source "$BR2_EXTERNAL_BITBOX_PATH/package/bbsplash/Config.in"
```

## package/attract-bitbox-layout/Config.in
```kconfig
config BR2_PACKAGE_ATTRACT_BITBOX_LAYOUT
    bool "attract-bitbox-layout"
    depends on BR2_PACKAGE_ATTRACTMODE
    help
        Custom theme for Attract Mode
```

## package/attractmode/Config.in
```kconfig
config BR2_PACKAGE_ATTRACTMODE
	bool "attractmode"
    depends on BR2_PACKAGE_EUDEV
	select BR2_PACKAGE_DEJAVU
	select BR2_PACKAGE_FFMPEG
	select BR2_PACKAGE_FFMPEG_SWSCALE
	select BR2_PACKAGE_SFML
    select BR2_PACKAGE_ZLIB
    select BR2_PACKAGE_RPI_USERLAND
	help
	  A graphical front-end for command line emulators that hides
	  the underlying operating system and is intended to be
	  controlled with a joystick or gamepad.

	  https://github.com/mickelson/attract
```

## package/bbconfigs/Config.in
```kconfig
config BR2_PACKAGE_BBCONFIGS
    bool "bbconfigs"
    help
        BitBox OS default configurations
```

## package/bbinit/Config.in
```kconfig
config BR2_PACKAGE_BBINIT
    bool "bbinit"
    select BR2_PACKAGE_DOSFSTOOLS
    select BR2_PACKAGE_DOSFSTOOLS_FSCK_FAT 
    help
        BitBox OS init script
```

## package/bbsplash/Config.in
```kconfig
config BR2_PACKAGE_BBSPLASH
    bool "bbsplash"
    select BR2_PACKAGE_FBV
    help
        Graphical splash for BitBox OS
```

## package/libretro-beetle-ngp/Config.in
```kconfig
config BR2_PACKAGE_LIBRETRO_BEETLE_NGP
	bool "libretro-beetle-ngp"
	depends on BR2_PACKAGE_RETROARCH
    help
        Beetle NeoGeo Pocket
```

## package/libretro-fbneo/Config.in
```kconfig
config BR2_PACKAGE_LIBRETRO_FBNEO
	bool "libretro-fbneo"
	depends on BR2_PACKAGE_RETROARCH
    help
        An Emulator for Arcade Games & Select Consoles.
        It is based on the emulators FinalBurn and old versions of MAME
```

## package/libretro-gambatte/Config.in
```kconfig
config BR2_PACKAGE_LIBRETRO_GAMBATTE
	bool "libretro-gambatte"
	depends on BR2_PACKAGE_RETROARCH
    help
        Gambatte is an accuracy-focused, open-source, cross-platform Game Boy Color emulator written in C++. It is based on hundreds of corner case hardware tests, as well as previous documentation and reverse engineering efforts.
```

## package/libretro-gpsp/Config.in
```kconfig
config BR2_PACKAGE_LIBRETRO_GPSP
	bool "libretro-gpsp"
	depends on BR2_PACKAGE_RETROARCH
    help
        Gameboy Advance emulator for Playstation Portable
```

## package/retroarch/Config.in
```kconfig
config BR2_PACKAGE_RETROARCH
    bool "retroarch"
    select BR2_PACKAGE_SDL2
    select BR2_PACKAGE_ALSA_LIB
    select BR2_PACKAGE_RPI_USERLAND
    help
        Libretro frontend
```

## package/retroleds/Config.in
```kconfig
config BR2_PACKAGE_RETROLEDS
    bool "retroleds"
    select BR2_PACKAGE_RPI_USERLAND
    select BR2_PACKAGE_RPI_WS281X
    help
        Lightweight ambilight implementation
```

## package/rpi_ws281x/Config.in
```kconfig
config BR2_PACKAGE_RPI_WS281X
    bool "rpi_ws281x"
    help
        Userspace Raspberry Pi library for controlling WS281X LEDs.
```
